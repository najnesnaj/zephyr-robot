## as5600_vl53l0x_publisher/build/Kconfig/arch/Kconfig.tmp
```kconfig
# Load Zephyr Arch Kconfig descriptions.
osource "/home/naj/zephyrproject/zephyr/arch/rx/Kconfig"
osource "/home/naj/zephyrproject/zephyr/arch/x86/Kconfig"
osource "/home/naj/zephyrproject/zephyr/arch/xtensa/Kconfig"
osource "/home/naj/zephyrproject/zephyr/arch/sparc/Kconfig"
osource "/home/naj/zephyrproject/zephyr/arch/riscv/Kconfig"
osource "/home/naj/zephyrproject/zephyr/arch/posix/Kconfig"
osource "/home/naj/zephyrproject/zephyr/arch/openrisc/Kconfig"
osource "/home/naj/zephyrproject/zephyr/arch/mips/Kconfig"
osource "/home/naj/zephyrproject/zephyr/arch/arm64/Kconfig"
osource "/home/naj/zephyrproject/zephyr/arch/arm/Kconfig"
osource "/home/naj/zephyrproject/zephyr/arch/arc/Kconfig"
```

## as5600_vl53l0x_publisher/build/Kconfig/boards/Kconfig.blackpill_f411ce.tmp
```kconfig
# Load board Kconfig descriptions.
osource "/home/naj/zephyrproject/zephyr/boards/weact/blackpill_f411ce/Kconfig.blackpill_f411ce"
```

## gripper/build/Kconfig/boards/Kconfig.sysbuild.tmp
```kconfig
# Load Sysbuild board Kconfig descriptions.
osource "/home/naj/zephyrproject/zephyr/boards/weact/blackpill_f411ce/Kconfig.sysbuild"
```
